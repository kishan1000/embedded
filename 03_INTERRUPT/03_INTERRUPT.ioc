# file: 03_INTERRUPT.ioc
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Mcu.Family=STM32F4
Mcu.Name=STM32F401C(B-C)Ux
Mcu.Package=UFQFPN48
NVIC.PriorityGroup=NVIC_PRIORITYGROUP_4
ProjectManager.HeapSize=0x200
ProjectManager.StackSize=0x400
ProjectManager.TargetToolchain=CMake
RCC.AHBFreq_Value=16000000
RCC.APB1Freq_Value=16000000
RCC.APB2Freq_Value=16000000
RCC.CortexFreq_Value=16000000
RCC.HSE_VALUE=25000000
RCC.HSI_VALUE=16000000
RCC.LSE_VALUE=32768
RCC.SYSCLKFreq_VALUE=16000000
RCC.VCOOutputFreq_Value=192000000
board=custom

// file: Core/Src/main.c
/* USER CODE BEGIN Header */
/**
  ******************************************************************************
  * @file           : main.c
  * @brief          : Main program body
  ******************************************************************************
  * @attention
  *
  * Copyright (c) 2026 STMicroelectronics.
  * All rights reserved.
  *
  * This software is licensed under terms that can be found in the LICENSE file
  * in the root directory of this software component.
  * If no LICENSE file comes with this software, it is provided AS-IS.
  *
  ******************************************************************************
  */
/* USER CODE END Header */
#include "main.h"
#include "stm32f401xc.h"
#include "stm32f4xx_ll_utils.h"

/* USER CODE BEGIN PD */
#define OUTPUT_PORT 2 // 2 = PORT C
#define OUTPUT_PIN 13
#define INPUT_PORT 0 // 0 = PORT A
#define INPUT_PIN 4
#define INTERRUPT_LINE 4

/* USER CODE END PD */

void SystemClock_Config(void);

int main(void)
{

  /* MCU Configuration--------------------------------------------------------*/

  /* Reset of all peripherals, Initializes the Flash interface and the Systick. */
  LL_APB2_GRP1_EnableClock(LL_APB2_GRP1_PERIPH_SYSCFG);
  LL_APB1_GRP1_EnableClock(LL_APB1_GRP1_PERIPH_PWR);

  /* System interrupt init*/
  NVIC_SetPriorityGrouping(NVIC_PRIORITYGROUP_4);

  /* SysTick_IRQn interrupt configuration */
  NVIC_SetPriority(SysTick_IRQn, NVIC_EncodePriority(NVIC_GetPriorityGrouping(),15, 0));

  /* Configure the system clock */
  SystemClock_Config();

  /* Initialize all configured peripherals */
  // Enabling clock and setting GPIO PIN C and OUTPUT PIN 13
  RCC->AHB1ENR |= 1 << OUTPUT_PORT;
  GPIOC->MODER &= ~(3 << OUTPUT_PIN*2);
  GPIOC->MODER |= 1 << (OUTPUT_PIN*2);

  // Enabling clock and setting GPIO PIN A and INPUT PIN 4
  RCC->AHB1ENR |= 1 << INPUT_PORT;
  GPIOA->MODER &= ~(3 << INPUT_PIN*2);
  GPIOA->PUPDR &= ~(3 << (INPUT_PIN*2));
  GPIOA->PUPDR |= 1 << (INPUT_PIN*2); // Pull-up -> open button = 1

  // Setting SYSCFG
  RCC->APB2ENR |= 1 << 14; // Enbale clock for SYSCFG (RCC_APB2ENR_SYSCFGEN)
  SYSCFG->EXTICR[1] &= ~(15 << (0*4)); // Setting Interrupt Line 4 for PA4

  // Setting EXTI peripheral for PA4
  EXTI->IMR |= 1 << INTERRUPT_LINE;
  EXTI->RTSR &= ~(1 << INTERRUPT_LINE);
  EXTI->FTSR |= 1 << INTERRUPT_LINE;

  // Setting NVIC
  NVIC_SetPriority(EXTI4_IRQn, 2); // Set priority (0 is highest)
  NVIC_EnableIRQ(EXTI4_IRQn); // Enable EXTI4 vector

  /* Infinite loop */
  while (1)
  {

  }
}

// Interrupt Handler for EXTI4
// Interupt coming from PA4
void EXTI4_IRQHandler(void)
{
  if(EXTI->PR & (1 << INTERRUPT_LINE))
  {
    // Toggle the LED
    LL_mDelay(100);
    if(GPIOC->ODR & (1 << OUTPUT_PIN))
    {
      GPIOC->BSRR |= 1 << (OUTPUT_PIN + 16);
    }
    else
    {
      GPIOC->BSRR |= 1 << OUTPUT_PIN;
    }
  }
  // Clear the pending interrupt flag by writing '1' to it
  EXTI->PR = 1 << INTERRUPT_LINE; // Not doing OR here because PR
                                  // is a special register where 1 will clear bits
                                  // and 0 do nothing
}

void SystemClock_Config(void)
{
  LL_FLASH_SetLatency(LL_FLASH_LATENCY_0);
  while(LL_FLASH_GetLatency()!= LL_FLASH_LATENCY_0)
  {
  }
  LL_PWR_SetRegulVoltageScaling(LL_PWR_REGU_VOLTAGE_SCALE2);
  LL_RCC_HSI_SetCalibTrimming(16);
  LL_RCC_HSI_Enable();

   /* Wait till HSI is ready */
  while(LL_RCC_HSI_IsReady() != 1)
  {

  }
  LL_RCC_SetAHBPrescaler(LL_RCC_SYSCLK_DIV_1);
  LL_RCC_SetAPB1Prescaler(LL_RCC_APB1_DIV_1);
  LL_RCC_SetAPB2Prescaler(LL_RCC_APB2_DIV_1);
  LL_RCC_SetSysClkSource(LL_RCC_SYS_CLKSOURCE_HSI);

   /* Wait till System clock is ready */
  while(LL_RCC_GetSysClkSource() != LL_RCC_SYS_CLKSOURCE_STATUS_HSI)
  {

  }
  LL_Init1msTick(16000000);
  LL_SetSystemCoreClock(16000000);
  LL_RCC_SetTIMPrescaler(LL_RCC_TIM_PRESCALER_TWICE);
}

void Error_Handler(void)
{
  __disable_irq();
  while (1)
  {
  }
}
